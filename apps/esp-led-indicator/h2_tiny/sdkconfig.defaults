## apps/esp-led-indicator/h2_tiny/sdkconfig.defaults
```kconfig
CONFIG_IDF_TARGET="esp32h2"

# Enable OpenThread
CONFIG_OPENTHREAD_ENABLED=y
CONFIG_OPENTHREAD_SRP_CLIENT=y
CONFIG_OPENTHREAD_LOG_LEVEL_DYNAMIC=n
CONFIG_OPENTHREAD_LOG_LEVEL_NOTE=y
CONFIG_ENABLE_CHIP_SHELL=y
CONFIG_OPENTHREAD_CLI=y

# Disable lwip ipv6 autoconfig
CONFIG_LWIP_IPV6_AUTOCONFIG=n

# LwIP config for OpenThread
CONFIG_LWIP_IPV6_NUM_ADDRESSES=8
CONFIG_LWIP_MULTICAST_PING=y

# MDNS platform
CONFIG_USE_MINIMAL_MDNS=n

# Disable STA for ESP32H2
CONFIG_ENABLE_WIFI_STATION=n

# Serial JTag enabled
CONFIG_ESP_CONSOLE_USB_SERIAL_JTAG=y
CONFIG_ESP_CONSOLE_SECONDARY_NONE=y
CONFIG_ESP_CONSOLE_USB_SERIAL_JTAG_ENABLED=y

# CHIP Thread Options
CONFIG_ENABLE_MATTER_OVER_THREAD=y

# ZAP config
CONFIG_ESP_MATTER_ZAP_PATH="main/zap/custom.zap"
```

## apps/esp-thread-br/optimized/examples/basic_thread_border_router/main/Kconfig.projbuild
```kconfig
menu "Custom Device/Firmware Configuration"

  config MIKE_MDNS_HOSTNAME
    string "Custom mDNS Hostname"
    default "esp-ot-br"
    help
      Use this option to set custom mDNS hostname.

  config MIKE_DEVICE_ID
    string "Custom Device ID"
    default "ESP32-Thread-BR"
    help
      Use this option to set custom DeviceID.

  config MIKE_FIRMWARE_VERSION
    string "Custom Firmware Version"
    default "1.0.0"
    help
      Use this option to set custom firmware version.

endmenu
```

## apps/esp-thread-br/optimized/examples/basic_thread_border_router/sdkconfig.defaults
```kconfig
# begin of ESP32-S3
CONFIG_IDF_TARGET="esp32s3"
CONFIG_OPENTHREAD_BR_AUTO_START=y
CONFIG_OPENTHREAD_BR_START_WEB=y
# end of ESP32-S3

# begin of Custom Firmware Config
CONFIG_MIKE_MDNS_HOSTNAME="ESP OTBR Mike Board N3 OTA"
CONFIG_MIKE_DEVICE_ID="ESP OTBR Mike Board N3 OTA"
CONFIG_MIKE_FIRMWARE_VERSION="1.0.1"
# end of Custom Firmware Config

# begin of Serial flasher config
CONFIG_ESPTOOLPY_FLASHSIZE_16MB=y
# end of Serial flasher config

# begin of Partition Table
CONFIG_PARTITION_TABLE_CUSTOM=y
CONFIG_PARTITION_TABLE_CUSTOM_FILENAME="partitions.csv"
CONFIG_PARTITION_TABLE_FILENAME="partitions.csv"
CONFIG_PARTITION_TABLE_OFFSET="0x8000"
CONFIG_PARTITION_TABLE_MD5=y
# end of Partition Table

# begin of Compiler options
CONFIG_COMPILER_OPTIMIZATION_SIZE=y
# end of Compiler options

# begin of Newlib
CONFIG_NEWLIB_NANO_FORMAT=y
# end of Newlib

# begin of mbedTLS
CONFIG_MBEDTLS_CMAC_C=y
CONFIG_MBEDTLS_SSL_PROTO_DTLS=y
CONFIG_MBEDTLS_KEY_EXCHANGE_ECJPAKE=y
CONFIG_MBEDTLS_ECJPAKE_C=y
# end of mbedTLS

# begin of OpenThread
CONFIG_OPENTHREAD_ENABLED=y
CONFIG_OPENTHREAD_BORDER_ROUTER=y
CONFIG_OPENTHREAD_CLI_OTA=y
CONFIG_OPENTHREAD_RCP_COMMAND=y
CONFIG_OPENTHREAD_RADIO_SPINEL_UART=y
# end of OpenThread

# begin of OpenThread Border Router Example
CONFIG_AUTO_UPDATE_RCP=y
# end of OpenThread Border Router Example

# begin of lwIP
CONFIG_LWIP_IPV6_FORWARD=y
CONFIG_LWIP_IPV6_NUM_ADDRESSES=12
CONFIG_LWIP_MULTICAST_PING=y
CONFIG_LWIP_NETIF_STATUS_CALLBACK=y
CONFIG_LWIP_HOOK_IP6_ROUTE_DEFAULT=y
CONFIG_LWIP_HOOK_ND6_GET_GW_DEFAULT=y
CONFIG_LWIP_HOOK_IP6_INPUT_CUSTOM=y
CONFIG_LWIP_IPV6_AUTOCONFIG=y
CONFIG_LWIP_HOOK_IP6_SELECT_SRC_ADDR_CUSTOM=y
CONFIG_LWIP_FORCE_ROUTER_FORWARDING=y
# end of lwIP

# begin of mDNS
CONFIG_MDNS_MULTIPLE_INSTANCE=y
CONFIG_MDNS_MAX_SERVICES=200
# end of mDNS

# begin of ESP System Settings
CONFIG_ESP_SYSTEM_EVENT_TASK_STACK_SIZE=3584
# end of ESP System Settings

# begin of ESP Border Router Board Kit
CONFIG_ESP_BR_BOARD_DEV_KIT=y
CONFIG_ESP_CONSOLE_USB_SERIAL_JTAG=y
# end of ESP Border Router Board Kit

# begin of Ethernet
#CONFIG_EXAMPLE_CONNECT_ETHERNET=y
#CONFIG_EXAMPLE_ETHERNET_EMAC_TASK_STACK_SIZE=2048
#CONFIG_EXAMPLE_USE_SPI_ETHERNET=y
#CONFIG_EXAMPLE_USE_W5500=y
#CONFIG_EXAMPLE_ETH_SPI_HOST=2
#CONFIG_EXAMPLE_ETH_SPI_SCLK_GPIO=21
#CONFIG_EXAMPLE_ETH_SPI_MOSI_GPIO=45
#CONFIG_EXAMPLE_ETH_SPI_MISO_GPIO=38
#CONFIG_EXAMPLE_ETH_SPI_CS_GPIO=41
#CONFIG_EXAMPLE_ETH_SPI_CLOCK_MHZ=36
#CONFIG_EXAMPLE_ETH_SPI_INT_GPIO=39
#CONFIG_EXAMPLE_ETH_PHY_RST_GPIO=40
#CONFIG_EXAMPLE_ETH_PHY_ADDR=1
# end of Ethernet

# begin of Wi-Fi
CONFIG_EXAMPLE_CONNECT_WIFI=y
CONFIG_EXAMPLE_PROVIDE_WIFI_CONSOLE_CMD=y
CONFIG_EXAMPLE_WIFI_SSID="NETIS_WIFI_24"
CONFIG_EXAMPLE_WIFI_PASSWORD="66nilozom"
CONFIG_EXAMPLE_WIFI_CONN_MAX_RETRY=1000000
# end of Wi-Fi

# begin of http server
CONFIG_HTTPD_MAX_REQ_HDR_LEN=1024
# end of http server
```

## apps/ha_matter_devices/esp-idf/sdkconfig.defaults
```kconfig
CONFIG_IDF_TARGET="esp32h2"

# Serial flasher config
CONFIG_ESPTOOLPY_FLASHSIZE_4MB=y
CONFIG_ESPTOOLPY_FLASHSIZE="4MB"
#CONFIG_ESPTOOLPY_MONITOR_BAUD=460800

# Partition Table
CONFIG_PARTITION_TABLE_CUSTOM=y
CONFIG_PARTITION_TABLE_CUSTOM_FILENAME="partitions.csv"
CONFIG_PARTITION_TABLE_FILENAME="partitions.csv"
CONFIG_PARTITION_TABLE_OFFSET=0x8000
CONFIG_PARTITION_TABLE_MD5=y

# Wireless Coexistence
CONFIG_ESP_COEX_SW_COEXIST_ENABLE=n

# OpenThread
CONFIG_OPENTHREAD_ENABLED=y
CONFIG_OPENTHREAD_RADIO=y
CONFIG_OPENTHREAD_DIAG=n
CONFIG_OPENTHREAD_COMMISSIONER=n
CONFIG_OPENTHREAD_JOINER=n
CONFIG_OPENTHREAD_BORDER_ROUTER=n
CONFIG_OPENTHREAD_CLI=n
CONFIG_OPENTHREAD_SRP_CLIENT=n
CONFIG_OPENTHREAD_DNS_CLIENT=n


# Deprecated options for backward compatibility
CONFIG_LOG_BOOTLOADER_LEVEL_ERROR=y
CONFIG_LOG_BOOTLOADER_LEVEL_INFO=n

# Configurations for optimizing the size of ot_rcp firmware
CONFIG_COMPILER_OPTIMIZATION_SIZE=y
CONFIG_COMPILER_OPTIMIZATION_ASSERTIONS_SILENT=y
CONFIG_COMPILER_OPTIMIZATION_CHECKS_SILENT=y
CONFIG_COMPILER_SAVE_RESTORE_LIBCALLS=y
CONFIG_ESP_ERR_TO_NAME_LOOKUP=n
CONFIG_ESP_SYSTEM_PANIC_SILENT_REBOOT=y
CONFIG_LOG_DEFAULT_LEVEL_NONE=y
CONFIG_NEWLIB_NANO_FORMAT=y
CONFIG_OPENTHREAD_LOG_LEVEL_DYNAMIC=n
CONFIG_OPENTHREAD_LOG_LEVEL_NONE=y

# ESP-Driver:USB Serial/JTAG Configuration
#CONFIG_USJ_ENABLE_USB_SERIAL_JTAG=y
#CONFIG_ESP_CONSOLE_USB_SERIAL_JTAG=y
#CONFIG_ESP_CONSOLE_SECONDARY_NONE=y
#CONFIG_ESP_CONSOLE_USB_SERIAL_JTAG_ENABLED=y

# Bootloder Log
#CONFIG_BOOTLOADER_LOG_LEVEL_INFO=y
#CONFIG_BOOTLOADER_LOG_LEVEL=3

# Bootloder Log Format
#CONFIG_BOOTLOADER_LOG_COLORS=y
#CONFIG_BOOTLOADER_LOG_TIMESTAMP_SOURCE_CPU_TICKS=y

# Log Level
#CONFIG_LOG_DEFAULT_LEVEL_INFO=y
#CONFIG_LOG_DEFAULT_LEVEL=3
#CONFIG_LOG_MAXIMUM_LEVEL_VERBOSE=y
#CONFIG_LOG_MAXIMUM_LEVEL=5

# Log Format
#CONFIG_LOG_COLORS=y
#CONFIG_LOG_TIMESTAMP_SOURCE_RTOS=y

#CONFIG_MONITOR_BAUD=460800
```

## apps/mike_h2_multiclimate_ai/sdkconfig.defaults
```kconfig
CONFIG_IDF_TARGET="esp32h2"
CONFIG_ESPTOOLPY_FLASHSIZE_4MB=y

#enable BT
CONFIG_BT_ENABLED=y
CONFIG_BT_NIMBLE_ENABLED=y

#disable BT connection reattempt
CONFIG_BT_NIMBLE_ENABLE_CONN_REATTEMPT=n

# Use a custom partition table
CONFIG_PARTITION_TABLE_CUSTOM=y
CONFIG_PARTITION_TABLE_FILENAME="partitions.csv"
CONFIG_PARTITION_TABLE_OFFSET=0xC000

#enable lwIP route hooks
CONFIG_LWIP_HOOK_IP6_ROUTE_DEFAULT=y
CONFIG_LWIP_HOOK_ND6_GET_GW_DEFAULT=y

# disable softap by default
CONFIG_ESP_WIFI_SOFTAP_SUPPORT=n

# Enable OTA Requestor
CONFIG_ENABLE_OTA_REQUESTOR=y

# Enable HKDF in mbedtls
CONFIG_MBEDTLS_HKDF_C=y

# Time synchronization
CONFIG_OPENTHREAD_TIME_SYNC=y
CONFIG_ENABLE_SNTP_TIME_SYNC=y



#-----------------------


# Enable OpenThread
CONFIG_OPENTHREAD_ENABLED=y
CONFIG_OPENTHREAD_SRP_CLIENT=y
CONFIG_OPENTHREAD_LOG_LEVEL_DYNAMIC=n
CONFIG_OPENTHREAD_LOG_LEVEL_NOTE=y
CONFIG_ENABLE_CHIP_SHELL=y
CONFIG_OPENTHREAD_CLI=y

# Disable lwip ipv6 autoconfig
CONFIG_LWIP_IPV6_AUTOCONFIG=n

# LwIP config for OpenThread
CONFIG_LWIP_IPV6_NUM_ADDRESSES=8
CONFIG_LWIP_MULTICAST_PING=y

# MDNS platform
CONFIG_USE_MINIMAL_MDNS=n

# Disable STA for ESP32H2
CONFIG_ENABLE_WIFI_STATION=n

# Serial JTag enabled
CONFIG_ESP_CONSOLE_USB_SERIAL_JTAG=y
CONFIG_ESP_CONSOLE_SECONDARY_NONE=y
CONFIG_ESP_CONSOLE_USB_SERIAL_JTAG_ENABLED=y

# CHIP Thread Options
CONFIG_ENABLE_MATTER_OVER_THREAD=y

# Device Identification Options
CONFIG_DEFAULT_DEVICE_HARDWARE_VERSION=2


# Настройки watchdog
CONFIG_ESP_TASK_WDT=y
CONFIG_ESP_TASK_WDT_PANIC=y
CONFIG_ESP_TASK_WDT_TIMEOUT_S=5
CONFIG_FREERTOS_HZ=1000
```

## apps/mike_h2_sensors/sdkconfig.defaults
```kconfig
CONFIG_IDF_TARGET="esp32h2"
CONFIG_ESPTOOLPY_FLASHSIZE_4MB=y

#enable BT
CONFIG_BT_ENABLED=y
CONFIG_BT_NIMBLE_ENABLED=y

#disable BT connection reattempt
CONFIG_BT_NIMBLE_ENABLE_CONN_REATTEMPT=n

# Use a custom partition table
CONFIG_PARTITION_TABLE_CUSTOM=y
CONFIG_PARTITION_TABLE_FILENAME="partitions.csv"
CONFIG_PARTITION_TABLE_OFFSET=0xC000

#enable lwIP route hooks
CONFIG_LWIP_HOOK_IP6_ROUTE_DEFAULT=y
CONFIG_LWIP_HOOK_ND6_GET_GW_DEFAULT=y

# disable softap by default
CONFIG_ESP_WIFI_SOFTAP_SUPPORT=n

# Enable OTA Requestor
CONFIG_ENABLE_OTA_REQUESTOR=y

# Enable HKDF in mbedtls
CONFIG_MBEDTLS_HKDF_C=y

# Time synchronization
CONFIG_OPENTHREAD_TIME_SYNC=y
CONFIG_ENABLE_SNTP_TIME_SYNC=y



#-----------------------


# Enable OpenThread
CONFIG_OPENTHREAD_ENABLED=y
CONFIG_OPENTHREAD_SRP_CLIENT=y
CONFIG_OPENTHREAD_LOG_LEVEL_DYNAMIC=n
CONFIG_OPENTHREAD_LOG_LEVEL_NOTE=y
CONFIG_ENABLE_CHIP_SHELL=y
CONFIG_OPENTHREAD_CLI=y

# Disable lwip ipv6 autoconfig
CONFIG_LWIP_IPV6_AUTOCONFIG=n

# LwIP config for OpenThread
CONFIG_LWIP_IPV6_NUM_ADDRESSES=8
CONFIG_LWIP_MULTICAST_PING=y

# MDNS platform
CONFIG_USE_MINIMAL_MDNS=n

# Disable STA for ESP32H2
CONFIG_ENABLE_WIFI_STATION=n

# Serial JTag enabled
CONFIG_ESP_CONSOLE_USB_SERIAL_JTAG=y
CONFIG_ESP_CONSOLE_SECONDARY_NONE=y
CONFIG_ESP_CONSOLE_USB_SERIAL_JTAG_ENABLED=y

# CHIP Thread Options
CONFIG_ENABLE_MATTER_OVER_THREAD=y

# Device Identification Options
CONFIG_DEFAULT_DEVICE_HARDWARE_VERSION=2


#========================================================


#CONFIG_ESP_MATTER_ENABLE_DATA_MODEL=1
#CONFIG_ESP_MATTER_COMMISSIONER_ENABLE=1
#CONFIG_ESP_MATTER_MAX_DEVICE_TYPE_CNT=4
#CONFIG_ESP_MATTER_MAX_ENDPOINT_COUNT=4
#
## Конфигурация Wi-Fi
#CONFIG_ESP_WIFI_SSID="your_wifi_ssid"
#CONFIG_ESP_WIFI_PASSWORD="your_wifi_password"
#
## Конфигурация Bluetooth
#CONFIG_BT_ENABLED=y
#CONFIG_BT_LE_ENABLED=y
#
## Параметры OTA
#CONFIG_ESP_MATTER_OTA_REQUESTOR=y
#CONFIG_ESP_MATTER_OTA_DELAYED_APPLY_TIME=0
#
## Размер стека для задач
#CONFIG_ESP_MATTER_THREAD_TASK_STACK=4096
#CONFIG_ESP_MATTER_COMMISSIONER_TASK_STACK=4096

# Sensors configuration
CONFIG_HCSR501_ENABLED=y
CONFIG_RCWL0516_ENABLED=y
CONFIG_HCSR04_ENABLED=y
CONFIG_SENSOR_POLL_PERIOD_MS=1000

# GPIO Configuration
CONFIG_HCSR501_PIR_GPIO=4
CONFIG_RCWL0516_MICROWAVE_GPIO=5
CONFIG_HCSR04_TRIG_GPIO=6
CONFIG_HCSR04_ECHO_GPIO=7
CONFIG_BUTTON_GPIO=0

## Отладка
#CONFIG_LOG_DEFAULT_LEVEL_INFO=y
#CONFIG_ESP_MATTER_LOG_DEFAULT_LEVEL=3
```

## apps/mike_on_off/sdkconfig.defaults.esp32h2
```kconfig
CONFIG_IDF_TARGET="esp32h2"

# Enable OpenThread
CONFIG_OPENTHREAD_ENABLED=y
CONFIG_OPENTHREAD_SRP_CLIENT=y
CONFIG_OPENTHREAD_LOG_LEVEL_DYNAMIC=n
CONFIG_OPENTHREAD_LOG_LEVEL_NOTE=y
CONFIG_OPENTHREAD_CLI=n

# Disable lwip ipv6 autoconfig
CONFIG_LWIP_IPV6_AUTOCONFIG=n

# LwIP config for OpenThread
CONFIG_LWIP_IPV6_NUM_ADDRESSES=8
CONFIG_LWIP_MULTICAST_PING=y

# MDNS platform
CONFIG_USE_MINIMAL_MDNS=n

# Disable STA for ESP32H2
CONFIG_ENABLE_WIFI_STATION=n

# Plugs
CONFIG_NUM_VIRTUAL_PLUGS=8
CONFIG_GPIO_PLUG_1=0
CONFIG_GPIO_PLUG_2=1
CONFIG_GPIO_PLUG_3=2
CONFIG_GPIO_PLUG_4=3
CONFIG_GPIO_PLUG_5=4
CONFIG_GPIO_PLUG_6=5
CONFIG_GPIO_PLUG_7=10
CONFIG_GPIO_PLUG_8=11

# Serial JTag enebled
CONFIG_ESP_CONSOLE_USB_SERIAL_JTAG=y
CONFIG_ESP_CONSOLE_SECONDARY_NONE=y
CONFIG_ESP_CONSOLE_USB_SERIAL_JTAG_ENABLED=y

# CHIP Thread Options
CONFIG_ENABLE_MATTER_OVER_THREAD=y
```

## apps/mike_on_off_c6/sdkconfig.defaults.esp32c6
```kconfig
CONFIG_IDF_TARGET="esp32c6"

# Enable OpenThread
CONFIG_OPENTHREAD_ENABLED=y
CONFIG_OPENTHREAD_SRP_CLIENT=y
CONFIG_OPENTHREAD_LOG_LEVEL_DYNAMIC=n
CONFIG_OPENTHREAD_LOG_LEVEL_NOTE=y
CONFIG_OPENTHREAD_CLI=y

# Disable lwip ipv6 autoconfig
CONFIG_LWIP_IPV6_AUTOCONFIG=n

# LwIP config for OpenThread
CONFIG_LWIP_IPV6_NUM_ADDRESSES=8
CONFIG_LWIP_MULTICAST_PING=y

# MDNS platform
CONFIG_USE_MINIMAL_MDNS=n

# Disable STA for ESP32C6
CONFIG_ENABLE_WIFI_STATION=n

CONFIG_ESPTOOLPY_FLASHSIZE_16MB=y




# ADC and ADC Calibration
CONFIG_ADC_ONESHOT_CTRL_FUNC_IN_IRAM=y
CONFIG_ADC_CONTINUOUS_ISR_IRAM_SAFE=y
CONFIG_ADC_ENABLE_DEBUG_LOG=y

# Legacy ADC Calibration Configuration
CONFIG_ADC_CALI_SUPPRESS_DEPRECATE_WARN=y
```
