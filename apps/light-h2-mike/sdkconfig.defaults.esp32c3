## apps/light-h2-mike/sdkconfig.defaults.esp32c3
```kconfig
CONFIG_IDF_TARGET="esp32c3"
CONFIG_DEFAULT_WIFI_SSID="MIKE_WIFI_24"
CONFIG_DEFAULT_WIFI_PASSWORD="66nilozom"
CONFIG_ENABLE_WIFI_AP=y


# ESP32-C3-DevKitC-02 Settings
# Buttons
CONFIG_BSP_BUTTONS_NUM=1
CONFIG_BSP_BUTTON_1_TYPE_GPIO=y
CONFIG_BSP_BUTTON_1_GPIO=9
CONFIG_BSP_BUTTON_1_LEVEL=0
# LEDs
CONFIG_BSP_LEDS_NUM=1
CONFIG_BSP_LED_TYPE_RGB=y
CONFIG_BSP_LED_RGB_GPIO=8
CONFIG_BSP_LED_RGB_BACKEND_RMT=y
```

## apps/mike_h2_tiny_xFFF2/sdkconfig.defaults
```kconfig
CONFIG_IDF_TARGET="esp32h2"
CONFIG_ESPTOOLPY_FLASHSIZE_4MB=y

# Device Identification Options
CONFIG_DEVICE_VENDOR_ID=0xFFF2
CONFIG_DEVICE_PRODUCT_ID=0x8000
CONFIG_DEFAULT_DEVICE_HARDWARE_VERSION=1
CONFIG_DEVICE_SOFTWARE_VERSION_NUMBER=1
CONFIG_DEVICE_TYPE=0

#--> recommended for ESP32-H2 optimization:
CONFIG_ESP_MATTER_MAX_DYNAMIC_ENDPOINT_COUNT=8
CONFIG_ESP_MATTER_MAX_DEVICE_TYPE_COUNT=8
CONFIG_FREERTOS_PLACE_FUNCTIONS_INTO_FLASH=y
CONFIG_RINGBUF_PLACE_FUNCTIONS_INTO_FLASH=y
CONFIG_HEAP_PLACE_FUNCTION_INTO_FLASH=y
CONFIG_ESP_SYSTEM_EVENT_QUEUE_SIZE=16
CONFIG_MAX_EVENT_QUEUE_SIZE=20
#--> if a failure occurs during the pairing process, increase the value from 6144 to 10240 (default = 8192)
CONFIG_CHIP_TASK_STACK_SIZE=10240
//--> from 2048 to 2304 (default = 2304)
CONFIG_ESP_SYSTEM_EVENT_TASK_STACK_SIZE=2048
//--> from 3072 to 5120 (default = 3584)
CONFIG_ESP_MAIN_TASK_STACK_SIZE=3072
//--> from 2048 to 4096 (default = 2048)
CONFIG_ESP_MINIMAL_SHARED_STACK_SIZE=2048


#enable BT
CONFIG_BT_ENABLED=y
CONFIG_BT_NIMBLE_ENABLED=y

#disable BT connection reattempt
CONFIG_BT_NIMBLE_ENABLE_CONN_REATTEMPT=n

# Use a custom partition table
CONFIG_PARTITION_TABLE_CUSTOM=y
CONFIG_PARTITION_TABLE_FILENAME="partitions.csv"
CONFIG_PARTITION_TABLE_OFFSET=0xC000

#enable lwIP route hooks
CONFIG_LWIP_HOOK_IP6_ROUTE_DEFAULT=y
CONFIG_LWIP_HOOK_ND6_GET_GW_DEFAULT=y

# disable softap by default
CONFIG_ESP_WIFI_SOFTAP_SUPPORT=n

# Enable OTA Requestor
CONFIG_ENABLE_OTA_REQUESTOR=y

# Enable HKDF in mbedtls
CONFIG_MBEDTLS_HKDF_C=y

# Time synchronization
CONFIG_OPENTHREAD_TIME_SYNC=y
CONFIG_ENABLE_SNTP_TIME_SYNC=y



#-----------------------


# Enable OpenThread
CONFIG_OPENTHREAD_ENABLED=y
CONFIG_OPENTHREAD_SRP_CLIENT=y
CONFIG_OPENTHREAD_LOG_LEVEL_DYNAMIC=n
CONFIG_OPENTHREAD_LOG_LEVEL_NOTE=y
CONFIG_ENABLE_CHIP_SHELL=y
CONFIG_OPENTHREAD_CLI=y

# Disable lwip ipv6 autoconfig
CONFIG_LWIP_IPV6_AUTOCONFIG=n

# LwIP config for OpenThread
CONFIG_LWIP_IPV6_NUM_ADDRESSES=8
CONFIG_LWIP_MULTICAST_PING=y

# MDNS platform
CONFIG_USE_MINIMAL_MDNS=n

# Disable STA for ESP32H2
CONFIG_ENABLE_WIFI_STATION=n

# Serial JTag enabled
CONFIG_ESP_CONSOLE_USB_SERIAL_JTAG=y
CONFIG_ESP_CONSOLE_SECONDARY_NONE=y
CONFIG_ESP_CONSOLE_USB_SERIAL_JTAG_ENABLED=y

# CHIP Thread Options
CONFIG_ENABLE_MATTER_OVER_THREAD=y

# Device Identification Options
CONFIG_DEFAULT_DEVICE_HARDWARE_VERSION=2
```

## apps/mike_h2_v2_multiclimate/sdkconfig.defaults
```kconfig
CONFIG_IDF_TARGET="esp32h2"
CONFIG_ESPTOOLPY_FLASHSIZE_4MB=y

#--> recommended for ESP32-H2 optimization:
CONFIG_ESP_SYSTEM_EVENT_TASK_STACK_SIZE=2048
CONFIG_ESP_MAIN_TASK_STACK_SIZE=3072
CONFIG_CHIP_TASK_STACK_SIZE=6144
CONFIG_ESP_MATTER_MAX_DYNAMIC_ENDPOINT_COUNT=8
CONFIG_ESP_MATTER_MAX_DEVICE_TYPE_COUNT=8
CONFIG_FREERTOS_PLACE_FUNCTIONS_INTO_FLASH=y
CONFIG_RINGBUF_PLACE_FUNCTIONS_INTO_FLASH=y
CONFIG_HEAP_PLACE_FUNCTION_INTO_FLASH=y
CONFIG_ESP_SYSTEM_EVENT_QUEUE_SIZE=16
CONFIG_MAX_EVENT_QUEUE_SIZE=20


#enable BT
CONFIG_BT_ENABLED=y
CONFIG_BT_NIMBLE_ENABLED=y

#disable BT connection reattempt
CONFIG_BT_NIMBLE_ENABLE_CONN_REATTEMPT=n

# Use a custom partition table
CONFIG_PARTITION_TABLE_CUSTOM=y
CONFIG_PARTITION_TABLE_FILENAME="partitions.csv"
CONFIG_PARTITION_TABLE_OFFSET=0xC000

#enable lwIP route hooks
CONFIG_LWIP_HOOK_IP6_ROUTE_DEFAULT=y
CONFIG_LWIP_HOOK_ND6_GET_GW_DEFAULT=y

# disable softap by default
CONFIG_ESP_WIFI_SOFTAP_SUPPORT=n

# Enable OTA Requestor
CONFIG_ENABLE_OTA_REQUESTOR=y

# Enable HKDF in mbedtls
CONFIG_MBEDTLS_HKDF_C=y

# Time synchronization
CONFIG_OPENTHREAD_TIME_SYNC=y
CONFIG_ENABLE_SNTP_TIME_SYNC=y



#-----------------------


# Enable OpenThread
CONFIG_OPENTHREAD_ENABLED=y
CONFIG_OPENTHREAD_SRP_CLIENT=y
CONFIG_OPENTHREAD_LOG_LEVEL_DYNAMIC=n
CONFIG_OPENTHREAD_LOG_LEVEL_NOTE=y
CONFIG_ENABLE_CHIP_SHELL=y
CONFIG_OPENTHREAD_CLI=y

# Disable lwip ipv6 autoconfig
CONFIG_LWIP_IPV6_AUTOCONFIG=n

# LwIP config for OpenThread
CONFIG_LWIP_IPV6_NUM_ADDRESSES=8
CONFIG_LWIP_MULTICAST_PING=y

# MDNS platform
CONFIG_USE_MINIMAL_MDNS=n

# Disable STA for ESP32H2
CONFIG_ENABLE_WIFI_STATION=n

# Serial JTag enabled
CONFIG_ESP_CONSOLE_USB_SERIAL_JTAG=y
CONFIG_ESP_CONSOLE_SECONDARY_NONE=y
CONFIG_ESP_CONSOLE_USB_SERIAL_JTAG_ENABLED=y

# CHIP Thread Options
CONFIG_ENABLE_MATTER_OVER_THREAD=y

# Device Identification Options
CONFIG_DEFAULT_DEVICE_HARDWARE_VERSION=2


# Настройки watchdog
CONFIG_ESP_TASK_WDT=y
CONFIG_ESP_TASK_WDT_PANIC=y
CONFIG_ESP_TASK_WDT_TIMEOUT_S=5
CONFIG_FREERTOS_HZ=1000

# SSD1306
CONFIG_I2C_PORT_1=y
```
